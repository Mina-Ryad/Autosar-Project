AUTOSAR XML (schema 00046)
package /Composition
  composition sw component type TempControlComposition
    component EcuAbstComp: type=TempHBridgeSWC
    component ApplicationSWC: type=TempControlSWC
    connect EcuAbstComp.PP_Temperature -> ApplicationSWC.RP_Temperature
    connect EcuAbstComp.PP_StartMotor -> ApplicationSWC.RP_StartMotor
    connect EcuAbstComp.PP_StopMotor -> ApplicationSWC.RP_StopMotor
